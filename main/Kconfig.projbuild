## main/Kconfig.projbuild
```kconfig
menu "ESPDrone Config"

    choice
        prompt "ESP_Drone hardware version"
        default TARGET_ESP32_S2_DRONE_V1_2 if IDF_TARGET_ESP32S3
        default TARGET_ESP32_S2_DRONE_V1_2 if IDF_TARGET_ESP32S2
        default TARGET_ESPLANE_V1 if IDF_TARGET_ESP32

        config TARGET_ESPLANE_V1
            bool "esplane with esp32 onboard(old version )"

        config TARGET_ESPLANE_V2_S2
            bool "esplane with esp32-s2 onboard"

        config TARGET_ESP32_S2_DRONE_V1_2
            bool "esp-drone with ESP32-S2/ESP32-S3 onboard"

    endchoice

    choice
        prompt "extend board version"
        default EXT_AUTO_DETECT
        config EXT_FLOW_TESTBOARD
            bool "use testboard 200616"
            help
                This board use wrong pin definition,only for test.
        config EXT_AUTO_DETECT
            bool "auto detect"
            help
                enable this to use extend board.
    endchoice

    menu "app set"
        config ENABLE_LEGACY_APP
            bool "Enable legacy ESPlane1.0 APP"
            default n
            help
                This enables the udp_server_rx2_task of wifi.
        config ENABLE_POSITION_HOLD_MODE
            bool "Enable position hold mode"
            default y
            help
                This enables position hold mode when pmw3901 sensors available.
        config ENABLE_COMMAND_MODE_SET
            bool "Enable \'setCommandermode\' to transform command"
            depends on ENABLE_POSITION_HOLD_MODE
            default y if ENABLE_POSITION_HOLD_MODE
            default n if !ENABLE_POSITION_HOLD_MODE
            help
                This enables assit mode when use old version app.
    endmenu

    menu "wireless config"
        config WIFI_BASE_SSID
            string "Wi-Fi Base SSID"
            default "ESP-DRONE"
            help
                Wi-Fi Base SSID, 1-16 characters. the final SSID will be BASE_SSID-MAC
        config WIFI_PASSWORD
            string "Wi-Fi Password"
            default "12345678"
            help
                Wi-Fi Password, 8-64 characters
        config WIFI_CHANNEL
            int "Wi-Fi/ESP-Now Channel"
            range 1 13
            default 6
            help
                Wi-Fi/ESP-Now Channel, 1-13
        config WIFI_MAX_STA_CONN
            int "Wi-Fi Max Station Connection"
            range 1 6
            default 3
            help
                Wi-Fi Max Station Connection, 1-6

        menu "STA Mode & Remote Server"
            config WIFI_ENABLE_STA_MODE
                bool "Enable STA+AP Mode (connect to router)"
                default n
                help
                    Enable STA+AP mode. The drone will connect to a router for internet access
                    while still providing AP for local control.

            config WIFI_STA_SSID
                string "Router SSID to connect"
                depends on WIFI_ENABLE_STA_MODE
                default "YourRouterSSID"
                help
                    The SSID of the router to connect to.

            config WIFI_STA_PASSWORD
                string "Router Password"
                depends on WIFI_ENABLE_STA_MODE
                default "YourRouterPassword"
                help
                    The password of the router to connect to.

            config WIFI_STA_RETRY_MAX
                int "STA connection retry count"
                depends on WIFI_ENABLE_STA_MODE
                range 3 20
                default 10
                help
                    Maximum number of retries to connect to the router.

            config REMOTE_SERVER_ENABLE
                bool "Enable Remote Server Connection"
                depends on WIFI_ENABLE_STA_MODE
                default n
                help
                    Enable TCP connection to a remote server for telemetry upload
                    and remote control. Server will be auto-discovered via UDP broadcast.

                config REMOTE_SERVER_IP
                    string "Remote Server IP Address (Fallback)"
                    depends on REMOTE_SERVER_ENABLE
                    default "192.168.1.100"
                    help
                        IP address of the remote server.
                        Used as fallback if UDP auto-discovery fails.

                config REMOTE_SERVER_PORT
                    int "Remote Server Port"
                    depends on REMOTE_SERVER_ENABLE
                    range 1 65535
                    default 8080
                    help
                        TCP port of the remote server.

                config REMOTE_SERVER_RECONNECT_INTERVAL
                    int "Reconnect interval (seconds)"
                    depends on REMOTE_SERVER_ENABLE
                    range 1 60
                    default 5
                    help
                        Interval between reconnection attempts when disconnected.

                config REMOTE_SERVER_HEARTBEAT_INTERVAL
                    int "Heartbeat interval (ms)"
                    depends on REMOTE_SERVER_ENABLE
                    range 100 10000
                    default 1000
                    help
                        Interval between heartbeat packets sent to the server.

            config REMOTE_SERVER_TELEMETRY_INTERVAL
                int "Telemetry upload interval (ms)"
                depends on REMOTE_SERVER_ENABLE
                range 20 1000
                default 100
                help
                    Interval between telemetry data uploads to the server.
        endmenu
    endmenu

    menu "calibration angle"
        config PITCH_CALIB
            int "PITCH_CALIB deg*100"
            range -200 200
            default 0
            help
                if PITCH error angle is 0.90,set this 90

        config ROLL_CALIB
            int "ROLL_CALIB deg*100"
            range -200 200
            default 0
            help
                if ROLL error angle is 0.90,set this 90
    endmenu

    menu "system"

        config BASE_STACK_SIZE
            int "base stack size for system task"
            range 512 1024
            default 1024 if IDF_TARGET_ESP32
            default 512 if IDF_TARGET_ESP32S2
            default 1024 if IDF_TARGET_ESP32S3

    endmenu

    menu "buzzer"

        config BUZZER_ON
            bool "enable buzzer to play sound"
            default y

        config BUZ1_PIN_POS
            int "BUZ1_PIN_POS GPIO number"
            range 0 34 if TARGET_ESPLANE_V1
            default 27 if TARGET_ESPLANE_V1
            range 0 43 if TARGET_ESPLANE_V2_S2
            default 21 if TARGET_ESPLANE_V2_S2
            range 0 43 if TARGET_ESP32_S2_DRONE_V1_2
            default 0 if TARGET_ESP32_S2_DRONE_V1_2
            help
                GPIO number (IOxx) BUZ1_PIN_POS (0=禁用)

        config BUZ2_PIN_NEG
            int "BUZ2_PIN_NEG GPIO number"
            range 0 34 if TARGET_ESPLANE_V1
            default 26 if TARGET_ESPLANE_V1
            range 0 43 if TARGET_ESPLANE_V2_S2
            default 48 if TARGET_ESPLANE_V2_S2
            range 0 43 if TARGET_ESP32_S2_DRONE_V1_2
            default 0 if TARGET_ESP32_S2_DRONE_V1_2
            help
                GPIO number (IOxx) BUZ2_PIN_NEG (0=禁用)

    endmenu

    menu "sensors config"
        menu "I2C Config"
        config I2C0_PIN_SDA
            int "I2C0_PIN_SDA GPIO number"
            range 0 43 
            default 20 
            help
                GPIO number (IOxx) I2C0_PIN_SDA 

        config I2C0_PIN_SCL
            int "I2C0_PIN_SCL GPIO number"
            range 0 43 
            default 19 
            help
                GPIO number (IOxx) I2C0_PIN_SCL 

        config I2C1_PIN_SDA
            int "I2C1_PIN_SDA GPIO number"
            range 0 43 
            default 18 
            help
                GPIO number (IOxx) I2C1_PIN_SDA

        config I2C1_PIN_SCL
            int "I2C1_PIN_SCL GPIO number"
            range 0 43 
            default 17 
            help
                GPIO number (IOxx) I2C1_PIN_SCL

        endmenu
        menu "SPI Config"
        config SPI_PIN_MISO
            int "SPI_PIN_MISO GPIO number"
            range 0 48 
            default 13
            help
                GPIO number (IOxx) SPI_PIN_MISO (SPI2 HSPI recommended)

        config SPI_PIN_MOSI
            int "SPI_PIN_MOSI GPIO number"
            range 0 48 
            default 11
            help
                GPIO number (IOxx) SPI_PIN_MOSI (SPI2 HSPI recommended)

        config SPI_PIN_CLK
            int "SPI_PIN_CLK GPIO number"
            range 0 48 
            default 12
            help
                GPIO number (IOxx) SPI_PIN_CLK (SPI2 HSPI recommended)

        config SPI_PIN_CS0
            int "SPI_PIN_CS0 GPIO number"
            range 0 48 
            default 45
            help
                GPIO number (IOxx) SPI_PIN_CS0 (BMI088 Accelerometer)

        config SPI_PIN_CS1
            int "SPI_PIN_CS1 GPIO number"
            range 0 48 
            default 10
            help
                GPIO number (IOxx) SPI_PIN_CS1 (BMI088 Gyroscope) - 独立引脚避免冲突

        config  BMI088_INT1_PIN
            int "BMI088_INT1_PIN GPIO number"
            range 0 43 
            default 14 
            help
                GPIO number (IOxx) BMI088_INT1_PIN

        config BMI088_INT3_PIN
            int "BMI088_INT3_PIN GPIO number"
            range 0 43 
            default 21 
            help
                GPIO number (IOxx) BMI088_INT3_PIN
        endmenu

        
        # config MPU_PIN_INT
        #     int "MPU_PIN_INT GPIO number"
        #     range 0 34 if TARGET_ESPLANE_V1
        #     default 19 if TARGET_ESPLANE_V1
        #     range 0 43 if TARGET_ESPLANE_V2_S2
        #     default 12 if TARGET_ESPLANE_V2_S2
        #     range 0 43 if TARGET_ESP32_S2_DRONE_V1_2
        #     default 12 if TARGET_ESP32_S2_DRONE_V1_2
        #     help
        #         GPIO number (IOxx) MPU_PIN_INT

        menu "ADC config"
        config ADC1_PIN
            int "EXT01_PIN GPIO number"
            range 32 39 if TARGET_ESPLANE_V1
            default 35 if TARGET_ESPLANE_V1
            range 1 10 if TARGET_ESPLANE_V2_S2
            default 2 if TARGET_ESPLANE_V2_S2
            range 1 10 if TARGET_ESP32_S2_DRONE_V1_2
            default 2 if TARGET_ESP32_S2_DRONE_V1_2
            help
                GPIO number (IOxx) ADC1_PIN
        endmenu

        # config EXT01_PIN
        #     int "EXT01_PIN GPIO number"
        #     range 0 34 if TARGET_ESPLANE_V1
        #     default 34 if TARGET_ESPLANE_V1
        #     range 0 43 if TARGET_ESPLANE_V2_S2
        #     default 1 if TARGET_ESPLANE_V2_S2
        #     range 0 43 if TARGET_ESP32_S2_DRONE_V1_2
        #     default 1 if TARGET_ESP32_S2_DRONE_V1_2
        #     help
        #         GPIO number (IOxx) EXT01_PIN

        menu "MTF01 Optical Flow Config"
            config ENABLE_MTF01
                bool "Enable MTF01 optical flow & rangefinder module"
                default y
                help
                    Enable MTF01 UART optical flow and rangefinder module.
                    MTF01 provides: distance(mm), flow velocity(cm/s@1m), signal strength.
                    Uses UART communication with custom Micolink protocol.

            config MTF01_UART_NUM
                int "MTF01 UART port number"
                depends on ENABLE_MTF01
                range 0 2
                default 2
                help
                    UART port number for MTF01 module (0, 1, or 2).
                    Avoid using UART0 as it is typically used for console/debug.
                    UART1 may be used by SBUS, so UART2 is recommended.

            config MTF01_RX_PIN
                int "MTF01 RX GPIO number"
                depends on ENABLE_MTF01
                range 0 48
                default 39
                help
                    GPIO number (IOxx) for MTF01 UART RX pin.
                    Connect to MTF01 TX pin.

            config MTF01_TX_PIN
                int "MTF01 TX GPIO number"
                depends on ENABLE_MTF01
                range 0 48
                default 40
                help
                    GPIO number (IOxx) for MTF01 UART TX pin.
                    Connect to MTF01 RX pin.

            config MTF01_BAUDRATE
                int "MTF01 UART baudrate"
                depends on ENABLE_MTF01
                default 115200
                help
                    UART baudrate for MTF01 communication.
                    Default: 115200 (check MTF01 datasheet for supported rates).

            config MTF01_MIN_DISTANCE
                int "MTF01 minimum valid distance (mm)"
                depends on ENABLE_MTF01
                range 2 50
                default 2
                help
                    Minimum valid distance measurement in millimeters.
                    Distance values below this threshold are considered invalid.
                    MTF01 default minimum: 2mm (0 means data unavailable).

            config MTF01_MAX_DISTANCE
                int "MTF01 maximum valid distance (mm)"
                depends on ENABLE_MTF01
                range 1000 10000
                default 10000
                help
                    Maximum valid distance measurement in millimeters.
                    Distance values above this threshold are considered invalid.
            endmenu
    endmenu

    menu "led config"
        config LED_PIN_BLUE
            int "LED_PIN_BLUE GPIO number"
            range 0 34 if TARGET_ESPLANE_V1
            default 18 if TARGET_ESPLANE_V1
            range 0 43 if TARGET_ESPLANE_V2_S2
            default 7 if TARGET_ESPLANE_V2_S2
            range 0 43 if TARGET_ESP32_S2_DRONE_V1_2
            default 0 if TARGET_ESP32_S2_DRONE_V1_2
            help
                GPIO number (IOxx) LED_PIN_BLUE (0=禁用)

        config LED_PIN_GREEN
            int "LED_PIN_GREEN GPIO number"
            range 0 34 if TARGET_ESPLANE_V1
            default 5 if TARGET_ESPLANE_V1
            range 0 43 if TARGET_ESPLANE_V2_S2
            default 17 if TARGET_ESPLANE_V2_S2
            range 0 43 if TARGET_ESP32_S2_DRONE_V1_2
            default 0 if TARGET_ESP32_S2_DRONE_V1_2
            help
                GPIO number (IOxx) LED_PIN_GREEN (0=禁用)

        config LED_PIN_RED
            int "LED_PIN_RED GPIO number"
            range 0 34 if TARGET_ESPLANE_V1
            default 23 if TARGET_ESPLANE_V1
            range 0 43 if TARGET_ESPLANE_V2_S2
            default 8 if TARGET_ESPLANE_V2_S2
            range 0 43 if TARGET_ESP32_S2_DRONE_V1_2
            default 0 if TARGET_ESP32_S2_DRONE_V1_2
            help
                GPIO number (IOxx) LED_PIN_RED (0=禁用)

    endmenu

    menu "motors config"

        config MOTOR01_PIN
            int "MOTOR01_PIN GPIO number"
            range 0 34 if TARGET_ESPLANE_V1
            default 4 if TARGET_ESPLANE_V1
            range 0 43 if TARGET_ESPLANE_V2_S2
            default 3 if TARGET_ESPLANE_V2_S2
            range 0 43 if TARGET_ESP32_S2_DRONE_V1_2
            default 7 if TARGET_ESP32_S2_DRONE_V1_2
            help
                GPIO number (IOxx) MOTOR01_PIN

        config MOTOR02_PIN
            int "MOTOR02_PIN GPIO number"
            range 0 34 if TARGET_ESPLANE_V1
            default 33 if TARGET_ESPLANE_V1
            range 0 43 if TARGET_ESPLANE_V2_S2
            default 4 if TARGET_ESPLANE_V2_S2
            range 0 43 if TARGET_ESP32_S2_DRONE_V1_2
            default 4 if TARGET_ESP32_S2_DRONE_V1_2
            help
                GPIO number (IOxx) MOTOR02_PIN

        config MOTOR03_PIN
            int "MOTOR03_PIN GPIO number"
            range 0 34 if TARGET_ESPLANE_V1
            default 32 if TARGET_ESPLANE_V1
            range 0 43 if TARGET_ESPLANE_V2_S2
            default 5 if TARGET_ESPLANE_V2_S2
            range 0 43 if TARGET_ESP32_S2_DRONE_V1_2
            default 6 if TARGET_ESP32_S2_DRONE_V1_2
            help
                GPIO number (IOxx) MOTOR03_PIN

        config MOTOR04_PIN
            int "MOTOR04_PIN GPIO number"
            range 0 34 if TARGET_ESPLANE_V1
            default 25 if TARGET_ESPLANE_V1
            range 0 43 if TARGET_ESPLANE_V2_S2
            default 6 if TARGET_ESPLANE_V2_S2
            range 0 43 if TARGET_ESP32_S2_DRONE_V1_2
            default 5 if TARGET_ESP32_S2_DRONE_V1_2
            help
                GPIO number (IOxx) MOTOR04_PIN
    endmenu

    menu "SBUS config"
        config ENABLE_SBUS
            bool "Enable SBUS receiver input"
            default y
            help
                Enable SBUS protocol support for external RC receiver.
                SBUS uses inverted UART at 100000 baud, 8E2 format.
            
        config SBUS_UART_NUM
            int "SBUS UART port number"
            depends on ENABLE_SBUS
            range 0 2
            default 1
            help
                UART port number for SBUS receiver (0, 1, or 2).
                Avoid using UART0 as it is typically used for console/debug.

        config SBUS_RX_PIN
            int "SBUS RX GPIO number"
            depends on ENABLE_SBUS
            range 0 48 
            default 41 
            help
                GPIO number (IOxx) connected to SBUS receiver signal output.
                Note: SBUS uses inverted UART signal, handled by ESP32 UART peripheral.

        config SBUS_SIGNAL_INVERTED
            bool "Enable software signal inversion"
            depends on ENABLE_SBUS
            default y
            help
                Enable ESP32 UART RX signal inversion in software.
                
                SBUS protocol uses inverted UART signal. You can handle this in two ways:
                - Hardware inverter: Use external inverter IC (e.g., 74HC04), disable this option
                - Software inversion: Enable this option to use ESP32 built-in UART inversion
                
                Most setups without hardware inverter should enable this option.
                If you have a hardware inverter on the signal line, disable this option.

        config SBUS_CH_THROTTLE
            int "Throttle channel (0-15)"
            depends on ENABLE_SBUS
            range 0 15
            default 2
            help
                SBUS channel for throttle control (typically channel 3, index 2)

        config SBUS_CH_ROLL
            int "Roll channel (0-15)"
            depends on ENABLE_SBUS
            range 0 15
            default 0
            help
                SBUS channel for roll control (typically channel 1, index 0)

        config SBUS_CH_PITCH
            int "Pitch channel (0-15)"
            depends on ENABLE_SBUS
            range 0 15
            default 1
            help
                SBUS channel for pitch control (typically channel 2, index 1)

        config SBUS_CH_YAW
            int "Yaw channel (0-15)"
            depends on ENABLE_SBUS
            range 0 15
            default 3
            help
                SBUS channel for yaw control (typically channel 4, index 3)

        config SBUS_CH_ARM
            int "Arm switch channel (0-15)"
            depends on ENABLE_SBUS
            range 0 15
            default 6
            help
                SBUS channel for arm/disarm switch (typically channel 7, index 6)

        config SBUS_CH_MODE
            int "Flight mode switch channel (0-15)"
            depends on ENABLE_SBUS
            range 0 15
            default 8
            help
                SBUS channel for flight mode switch (typically channel 9, index 8)

        menu "SBUS Endpoint Calibration"
            depends on ENABLE_SBUS

            config SBUS_CHANNEL_MIN
                int "Channel minimum value"
                range 0 1000
                default 240
                help
                    SBUS channel value when stick is at minimum position.
                    Standard: 172, Common range: 172-300.
                    Use VOFA or serial monitor to check your transmitter's actual value.

            config SBUS_CHANNEL_MAX
                int "Channel maximum value"
                range 1500 2047
                default 1807
                help
                    SBUS channel value when stick is at maximum position.
                    Standard: 1811, Common range: 1700-1811.
                    Use VOFA or serial monitor to check your transmitter's actual value.

            config SBUS_CHANNEL_CENTER
                int "Channel center value"
                range 800 1200
                default 1024
                help
                    SBUS channel value when stick is centered.
                    Standard: 992, Common range: 992-1024.
                    Use VOFA or serial monitor to check your transmitter's actual value.

            config SBUS_DEADBAND
                int "Stick deadband"
                range 0 100
                default 20
                help
                    Deadband around center position (in SBUS units).
                    Prevents drift when sticks are released to center.
        endmenu
    endmenu
                    


endmenu
```
