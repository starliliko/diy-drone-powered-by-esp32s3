## sdkconfig.defaults
```kconfig
# ======================== ESPDrone sdkconfig.defaults ========================
#
#  sdkconfig  idf.py set-target esp32s3 
# : 2026-03-10
# =============================================================================

# ========================  ========================
CONFIG_TARGET_ESP32_S2_DRONE_V1_2=y
CONFIG_EXT_AUTO_DETECT=y

# ========================  ========================
CONFIG_ENABLE_POSITION_HOLD_MODE=y
CONFIG_ENABLE_COMMAND_MODE_SET=y

# ======================== Wi-Fi  ========================
CONFIG_WIFI_BASE_SSID="ESP-DRONE"
CONFIG_WIFI_PASSWORD="12345678"
CONFIG_WIFI_CHANNEL=6
CONFIG_WIFI_MAX_STA_CONN=3

# STA  ()
CONFIG_WIFI_ENABLE_STA_MODE=y
CONFIG_WIFI_STA_SSID="BO"
CONFIG_WIFI_STA_PASSWORD="141173LI"
CONFIG_WIFI_STA_RETRY_MAX=10

#
CONFIG_REMOTE_SERVER_ENABLE=y
CONFIG_REMOTE_SERVER_IP="192.168.36.232"
CONFIG_REMOTE_SERVER_PORT=8080
CONFIG_REMOTE_SERVER_RECONNECT_INTERVAL=5
CONFIG_REMOTE_SERVER_HEARTBEAT_INTERVAL=1000
CONFIG_REMOTE_SERVER_TELEMETRY_INTERVAL=2

# ========================  ========================
CONFIG_PITCH_CALIB=0
CONFIG_ROLL_CALIB=0

# ========================  ========================
CONFIG_BASE_STACK_SIZE=1024

# ========================  (0=) ========================
CONFIG_BUZZER_ON=y
CONFIG_BUZ1_PIN_POS=0
CONFIG_BUZ2_PIN_NEG=0

# ======================== I2C  ========================
# I2C0 (MS5611 )
CONFIG_I2C0_PIN_SDA=20
CONFIG_I2C0_PIN_SCL=19
# I2C1
CONFIG_I2C1_PIN_SDA=18
CONFIG_I2C1_PIN_SCL=17

# ======================== SPI  (BMI088) ========================
CONFIG_SPI_PIN_MISO=13
CONFIG_SPI_PIN_MOSI=11
CONFIG_SPI_PIN_CLK=12
CONFIG_SPI_PIN_CS0=45
CONFIG_SPI_PIN_CS1=10

# ======================== BMI088  ========================
CONFIG_BMI088_INT1_PIN=14
CONFIG_BMI088_INT3_PIN=21

# ======================== ADC ========================
CONFIG_ADC1_PIN=2

# ======================== MTF01  ========================
CONFIG_ENABLE_MTF01=y
CONFIG_MTF01_UART_NUM=2
CONFIG_MTF01_RX_PIN=39
CONFIG_MTF01_TX_PIN=40
CONFIG_MTF01_BAUDRATE=115200
CONFIG_MTF01_MIN_DISTANCE=2
CONFIG_MTF01_MAX_DISTANCE=10000

# ======================== LED (0=) ========================
CONFIG_LED_PIN_BLUE=0
CONFIG_LED_PIN_GREEN=0
CONFIG_LED_PIN_RED=0

# ========================  ========================
CONFIG_MOTOR01_PIN=7
CONFIG_MOTOR02_PIN=4
CONFIG_MOTOR03_PIN=6
CONFIG_MOTOR04_PIN=5

# ======================== SBUS  ========================
CONFIG_ENABLE_SBUS=y
CONFIG_SBUS_UART_NUM=1
CONFIG_SBUS_RX_PIN=41
CONFIG_SBUS_SIGNAL_INVERTED=y
CONFIG_SBUS_CH_THROTTLE=2
CONFIG_SBUS_CH_ROLL=0
CONFIG_SBUS_CH_PITCH=1
CONFIG_SBUS_CH_YAW=3
CONFIG_SBUS_CH_ARM=6
CONFIG_SBUS_CH_MODE=8
CONFIG_SBUS_CHANNEL_MIN=240
CONFIG_SBUS_CHANNEL_MAX=1807
CONFIG_SBUS_CHANNEL_CENTER=1024
CONFIG_SBUS_DEADBAND=20

# ======================== FreeRTOS  ========================
CONFIG_FREERTOS_UNICORE=n
CONFIG_FREERTOS_NO_AFFINITY=0x7FFFFFFF
CONFIG_FREERTOS_CORETIMER_0=y
CONFIG_FREERTOS_OPTIMIZED_SCHEDULER=y
CONFIG_FREERTOS_HZ=1000
CONFIG_FREERTOS_SUPPORT_STATIC_ALLOCATION=y
CONFIG_FREERTOS_USE_STATS_FORMATTING_FUNCTIONS=y
CONFIG_FREERTOS_IDLE_TASK_STACKSIZE=2048
CONFIG_FREERTOS_ISR_STACKSIZE=2048
CONFIG_FREERTOS_ENABLE_BACKWARD_COMPATIBILITY=y
CONFIG_FREERTOS_TIMER_TASK_STACK_DEPTH=4096
CONFIG_FREERTOS_VTASKLIST_INCLUDE_COREID=y
CONFIG_FREERTOS_USE_TRACE_FACILITY=y
CONFIG_FREERTOS_GENERATE_RUN_TIME_STATS=y

# ========================  ========================
CONFIG_COMPILER_OPTIMIZATION_PERF=y
CONFIG_COMPILER_OPTIMIZATION_ASSERTIONS_ENABLE=y
CONFIG_COMPILER_STACK_CHECK_MODE_NONE=y

# ======================== Flash  ========================
CONFIG_ESPTOOLPY_FLASHMODE_QIO=y
CONFIG_ESPTOOLPY_FLASHFREQ_80M=y
CONFIG_ESPTOOLPY_FLASHSIZE_16MB=y

# ======================== Wi-Fi  ========================
CONFIG_ESP32_PHY_MAX_WIFI_TX_POWER=20
CONFIG_ESP32_PHY_MAX_TX_POWER=20

# ========================  ========================
#  IDLE  - 1kHz  CPU 
CONFIG_ESP_TASK_WDT_CHECK_IDLE_TASK_CPU0=n
CONFIG_ESP_TASK_WDT_CHECK_IDLE_TASK_CPU1=n
CONFIG_ESP_TASK_WDT_EN=y
CONFIG_ESP_TASK_WDT_INIT=y
CONFIG_ESP_TASK_WDT_TIMEOUT_S=5
```

## sdkconfig.defaults.esp32s3
```kconfig
CONFIG_FREERTOS_UNICORE=n
CONFIG_ESP32S3_DEFAULT_CPU_FREQ_240=y
CONFIG_ESP32S3_DEFAULT_CPU_FREQ_MHZ=240

CONFIG_ESPTOOLPY_FLASHSIZE_32MB=y
CONFIG_ESPTOOLPY_FLASHSIZE="32MB"
CONFIG_PARTITION_TABLE_CUSTOM=y
CONFIG_PARTITION_TABLE_CUSTOM_FILENAME="partitions.csv"
CONFIG_PARTITION_TABLE_FILENAME="partitions.csv"

# ==================== ESP32-S3-WROOM-2 Configuration ====================
CONFIG_IDF_TARGET_ESP32S3=y
CONFIG_IDF_TARGET="esp32s3"

# CPU Configuration
CONFIG_FREERTOS_UNICORE=n
CONFIG_ESP_DEFAULT_CPU_FREQ_MHZ_240=y
CONFIG_ESP_DEFAULT_CPU_FREQ_MHZ=240

# ==================== PSRAM Configuration ====================
CONFIG_SPIRAM=y
CONFIG_SPIRAM_MODE_OCT=y
CONFIG_SPIRAM_TYPE_ESPPSRAM64=y
CONFIG_SPIRAM_SPEED_80M=y
CONFIG_SPIRAM_SIZE=16777216

# PSRAM Memory Allocation
CONFIG_SPIRAM_USE_MALLOC=y
CONFIG_SPIRAM_MALLOC_ALWAYSINTERNAL=8192
CONFIG_SPIRAM_TRY_ALLOCATE_WIFI_LWIP=y

# PSRAM Code Execution - Reduces IRAM usage by moving code to PSRAM
CONFIG_SPIRAM_FETCH_INSTRUCTIONS=y
CONFIG_SPIRAM_RODATA=y

# ==================== Flash Configuration ====================
CONFIG_ESPTOOLPY_FLASHSIZE_32MB=y
CONFIG_ESPTOOLPY_FLASHSIZE="32MB"
CONFIG_ESPTOOLPY_FLASHMODE_QIO=y
CONFIG_ESPTOOLPY_FLASHFREQ_80M=y

# ==================== Partition Table ====================
CONFIG_PARTITION_TABLE_CUSTOM=y
CONFIG_PARTITION_TABLE_CUSTOM_FILENAME="partitions.csv"

# ==================== Performance Optimization ====================
CONFIG_COMPILER_OPTIMIZATION_PERF=y
CONFIG_FREERTOS_HZ=1000

# ==================== WiFi Configuration ====================
CONFIG_ESP_WIFI_STATIC_RX_BUFFER_NUM=8
CONFIG_ESP_WIFI_DYNAMIC_RX_BUFFER_NUM=16
CONFIG_ESP_WIFI_DYNAMIC_TX_BUFFER_NUM=16
CONFIG_ESP_WIFI_AMPDU_TX_ENABLED=y
CONFIG_ESP_WIFI_AMPDU_RX_ENABLED=y
```
